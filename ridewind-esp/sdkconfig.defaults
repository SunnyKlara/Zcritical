## ridewind-esp/sdkconfig.defaults
```kconfig
CONFIG_PARTITION_TABLE_CUSTOM=y
CONFIG_PARTITION_TABLE_CUSTOM_FILENAME="partitions.csv"
CONFIG_ESPTOOLPY_FLASHSIZE_16MB=y
CONFIG_ESPTOOLPY_FLASHSIZE="16MB"

# Bluetooth
CONFIG_BT_ENABLED=y
CONFIG_BT_BLUEDROID_ENABLED=y
CONFIG_BT_BLE_42_FEATURES_SUPPORTED=y
CONFIG_BT_BLE_DYNAMIC_ENV_MEMORY=y
CONFIG_BT_ALLOCATION_FROM_SPIRAM_FIRST=y

# WiFi — static RX must stay low (internal DMA only), dynamic restored to defaults (PSRAM)
CONFIG_ESP_WIFI_ENABLED=y
CONFIG_ESP_WIFI_STATIC_RX_BUFFER_NUM=4
CONFIG_ESP_WIFI_DYNAMIC_RX_BUFFER_NUM=32
CONFIG_ESP_WIFI_DYNAMIC_TX_BUFFER_NUM=32

# WiFi + BLE coexistence — critical for simultaneous operation
CONFIG_ESP_COEX_SW_COEXIST_ENABLE=y

# PSRAM — 8MB Octal embedded PSRAM
CONFIG_SPIRAM=y
CONFIG_SPIRAM_MODE_OCT=y
CONFIG_SPIRAM_SPEED_80M=y
CONFIG_SPIRAM_BOOT_INIT=y
CONFIG_SPIRAM_MALLOC_ALWAYSINTERNAL=4096
CONFIG_SPIRAM_MALLOC_RESERVE_INTERNAL=32768
CONFIG_SPIRAM_ALLOW_BSS_SEG_EXTERNAL_MEMORY=y

# RTOS
CONFIG_FREERTOS_HZ=1000

# LWIP — needed for TCP sockets
CONFIG_LWIP_SO_REUSE=y

# HTTP Server — WebSocket support for WiFi communication channel
CONFIG_HTTPD_WS_SUPPORT=y

# Brownout — disable to prevent reboot during BLE+WiFi init current spike
# (hardware supply issue, not software — USB cable may be too long/thin)
CONFIG_ESP_BROWNOUT_DET=n

# IRAM optimization — reduce IRAM usage to fit within segment
# WiFi/LWIP hot paths moved to flash (slight latency increase, acceptable for BLE app)
CONFIG_ESP_WIFI_IRAM_OPT=n
CONFIG_ESP_WIFI_RX_IRAM_OPT=n
CONFIG_LWIP_IRAM_OPTIMIZATION=n
# Move less-critical C library functions out of IRAM (PSRAM cache miss acceptable)
CONFIG_SPIRAM_CACHE_LIBTIME_IN_IRAM=n
CONFIG_SPIRAM_CACHE_LIBENV_IN_IRAM=n
CONFIG_SPIRAM_CACHE_LIBFILE_IN_IRAM=n
CONFIG_SPIRAM_CACHE_LIBMISC_IN_IRAM=n
CONFIG_SPIRAM_CACHE_LIBRAND_IN_IRAM=n
CONFIG_SPIRAM_CACHE_LIBNUMPARSER_IN_IRAM=n
CONFIG_SPIRAM_CACHE_LIBIO_IN_IRAM=n
CONFIG_SPIRAM_CACHE_LIBCHAR_IN_IRAM=n

# OTA Rollback — new firmware auto-rollback if it crashes before confirming
CONFIG_BOOTLOADER_APP_ROLLBACK_ENABLE=y

# App version (embedded in firmware image for OTA version checking)
CONFIG_APP_PROJECT_VER_FROM_CONFIG=y
CONFIG_APP_PROJECT_VER="1.0.0"
```
